## arch/arm64/configs/l762_defconfig
```kconfig
### Hisense product infomation configuriton
CONFIG_HISENSE_VENDOR_NAME="Hisense"
CONFIG_HISENSE_PRODUCT_NAME="l762"
CONFIG_HISENSE_PRODUCT_PLATFORM="sdm450"

### Hisense LCD configuriton
CONFIG_BL_I2C=y
CONFIG_BL_I2C_CURRENT_SET=y
CONFIG_ASYNC_UNBLANK_FB=y

### Fingerprint configuriton
CONFIG_FP_REPORT_WAKEUP_KEY=y
CONFIG_HS_FINGERPRINT=y
CONFIG_FINGERPRINT_CHIPONE=y
CONFIG_SAVE_AWAKEN_EVENT=y


### Hisense TP configuriton
# CONFIG_CHIPONE_TDDI_TOUCHSCREEN is not set
# CONFIG_CHIPONE_TDDI_HAS_RESET_PIN is not set
# CONFIG_CHIPONE_TDDI_GESTURE is not set
# CONFIG_CHIPONE_TDDI_INCELL_CHIP is not set
# CONFIG_CHIPONE_TDDI_GLOVE is not set
# CONFIG_CHIPONE_TDDI_CHARGER_DETECT is not set
CONFIG_TOUCHSCREEN_FT5X06=y
# CONFIG_FT_INCELL_CHIP is not set
# CONFIG_TOUCHSCREEN_FT5X06_GESTURE is not set
# CONFIG_TOUCHSCREEN_FT5X06_GESTURE_DRIVER is not set
# CONFIG_TOUCHSCREEN_FACE_DETECTION is not set
CONFIG_TOUCHSCREEN_FT5X06_GLOVE=y
CONFIG_TOUCHSCREEN_FT5X06_GFF_PANNEL=y
# CONFIG_TOUCHSCREEN_FT5X06_HALL is not set
# CONFIG_TOUCHSCREEN_FT5X06_PRAMUPDATE is not set
CONFIG_TOUCHSCREEN_FT5X06_APK_TEST=y
# CONFIG_TOUCHSCREEN_FT5X06_SUB is not set
# CONFIG_FT_SECURE_TOUCH is not set
CONFIG_TOUCHSCREEN_USB_CHECK=y
CONFIG_TOUCHSCREEN_FT5X06_FH=y
CONFIG_TOUCHSCREEN_WORK_MODE=y
### Hisense Charger configuriton
# CONFIG_QPNP_FG is not set
# CONFIG_QPNP_FG_GEN3 is not set
# CONFIG_SMB135X_CHARGER is not set
# CONFIG_SMB1355_SLAVE_CHARGER is not set
# CONFIG_SMB1351_USB_CHARGER is not set
# CONFIG_QPNP_SMB2 is not set
CONFIG_QPNP_SMB5=y
# CONFIG_SMB138X_CHARGER is not set
# CONFIG_QPNP_SMBCHARGER is not set
# CONFIG_QPNP_QNOVO is not set
# CONFIG_QPNP_TYPEC is not set
CONFIG_QPNP_QG=y
CONFIG_HISENSE_CHARGE_FG_FUNCTION=y
CONFIG_USB_EXT_TYPE_C_WUSB3801=y
CONFIG_HISENSE_SGM2540=y
# CONFIG_DUAL_ROLE_USB_INTF is not set

### Hisense Sensors configuriton
CONFIG_SENSORS=y
CONFIG_HS_SNS_ACC=y
# CONFIG_HS_SNS_AP_ACC is not set
CONFIG_HS_SNS_ADSP_ACC=y
CONFIG_ACC_SENSOR_VENDOR="BOSCH"
CONFIG_ACC_SENSOR_TYPE="BMI160"
CONFIG_HS_SNS_MAG=y
# CONFIG_HS_SNS_AP_MAG is not set
CONFIG_HS_SNS_ADSP_MAG=y
CONFIG_MAG_SENSOR_VENDOR="AKM"
CONFIG_MAG_SENSOR_TYPE="AK09918"
CONFIG_HS_SNS_GYRO=y
# CONFIG_HS_SNS_AP_GYRO is not set
CONFIG_HS_SNS_ADSP_GYRO=y
CONFIG_GYRO_SENSOR_VENDOR="BOSCH"
CONFIG_GYRO_SENSOR_TYPE="BMI160"
CONFIG_HS_SNS_ALS_PS=y
# CONFIG_HS_SNS_CM36686 is not set
# CONFIG_HS_SNS_CM32183 is not set
# CONFIG_HS_SNS_ELAN_ALSPS is not set
CONFIG_HS_SNS_STK3X1X=y
# CONFIG_HS_SNS_SAR is not set
# CONFIG_HS_SNS_A96T346 is not set
# CONFIG_HS_SNS_CM3232 is not set
# CONFIG_HS_SNS_UV is not set
# CONFIG_HS_SNS_BARO is not set
# CONFIG_HS_SNS_TEM_HUM is not set
CONFIG_HS_SNS_STEP=y
### Hisense Camera configuriton
CONFIG_HMCT_CAMERA_DEBUG=y
CONFIG_HMCT_LOW_BATTERY_FLASH_CTL=y
CONFIG_HMCT_ACTUATOR_POWERDOWN_MORESTEP=y
### add by gao

CONFIG_USELESS_RES_RECLAIM=y
CONFIG_HISENSE_SMART_SHRINK=y
CONFIG_HISENSE_SWAPPINESS_OPT=y
### NXP NFC-PN553
CONFIG_HISENSE_NFC_PN547=y

###for cpu freezer
CONFIG_HS_CGF_NOTIFY_EVENT=y
###unmovable isolate
CONFIG_HISENSE_UNMOVABLE_ISOLATE=y
CONFIG_HISENSE_UNMOVABLE_ISOLATE1_SIZE_MBYTES=256
CONFIG_HISENSE_UNMOVABLE_ISOLATE2_SIZE_MBYTES=64

CONFIG_HISENSE_SILENCE_REBOOT=y
```

## drivers/input/fingerprint/Kconfig
```kconfig
config HS_FINGERPRINT
	tristate "fingerprint drvier support"
	help
	  Say Y here to enable fingerprint driver support!

config FINGERPRINT_SUNWAVE_SW9651
	tristate "SUNWAVE SW9651 fingerprint drvier support"
	depends on HS_FINGERPRINT
	help
	  Say Y here to enable sunwave sw9651 driver support!
	 
config FINGERPRINT_FPC_FPC1291
	tristate "FPC FPC1145 fingerprint drvier support"
	depends on HS_FINGERPRINT
	help
	  Say Y here to enable FPC FPC1145 driver support!

config FINGERPRINT_FPC_IS_1291
        tristate "FPC vendor fingerprint name is 1291"
        depends on HS_FINGERPRINT
        help
          Say Y here to ensure FPC fingerprintIC is 1291!

config FINGERPRINT_GOODIX_GF5126
	tristate "GOODIX GF5126 fingerprint drvier support"
	depends on HS_FINGERPRINT
	help
	  Say Y here to enable FPC GOODIX GF5126 driver support!

config FINGERPRINT_NAV_DIRECTION_CHANGE
	bool "Fingerprint nav direction change"
	default n
	depends on HS_FINGERPRINT
	help
	  Say Y here to change fingerprint navigation direction!

config FINGERPRINT_CHIPONE
	tristate "CHIPONE fingerprint driver support"
	depends on HS_FINGERPRINT
	help
	  Say Y here to enable CHIPONE Fingerpirnt driver support!
```

## drivers/input/touchscreen/focaltech/Kconfig
```kconfig
#
# Focaltech Touchscreen driver configuration
#

config FT_INCELL_CHIP
       bool "FocalTech touchscreens FH support."
       depends on TOUCHSCREEN_FT5X06
       help
         Say Y here if you need a ft5X06 touchscreen FH function.
	 else say N

config TOUCHSCREEN_FT5X06_FH
       bool "FocalTech touchscreens FH support."
       depends on TOUCHSCREEN_USB_CHECK
       help
         Say Y here if you need a ft5X06 touchscreen FH function.
	 else say N

config TOUCHSCREEN_FT5X06_GESTURE
       bool "FocalTech touchscreens gesture function"
       depends on TOUCHSCREEN_FT5X06
       help
         Say Y here if you need a ft5X06 touchscreen gesture function.
	 else say N

config TOUCHSCREEN_FT5X06_GESTURE_DRIVER
       bool "FocalTech touchscreens gesture function realized in driver"
       depends on TOUCHSCREEN_FT5X06_GESTURE
       help
         Say Y here if you need a ft5X06 touchscreen gesture function in driver.
	 else say N
	 
config TOUCHSCREEN_FACE_DETECTION
       bool "FocalTech touchscreens face detection function realized in driver"
       depends on TOUCHSCREEN_FT5X06
       help
         Say Y here if you need a ft5X06 touchscreen gesture function in driver.
	 else say N

config TOUCHSCREEN_FT5X06_GLOVE
       bool "FocalTech touchscreens glove mode function realized in driver"
       depends on TOUCHSCREEN_FT5X06
       help
         Say Y here if you need a ft5X06 glove mode in driver.
	 else say N

config TOUCHSCREEN_FT5X06_HALL
       bool "FocalTech touchscreens hall mode function realized in driver"
       depends on TOUCHSCREEN_FT5X06
       help
         Say Y here if you need a ft5X06 hall mode in driver.
	 else say N

config TOUCHSCREEN_FT5X06_PRAMUPDATE
       bool "FocalTech touchscreens ft8719 pramboot data in driver"
       depends on TOUCHSCREEN_FT5X06
       default n
       help
         Say Y here if you need a ft8719 pramboot data in driver.
	 else say N

config TOUCHSCREEN_FT5X06_APK_TEST
       bool "FocalTech touchscreens apk test function realized in driver"
       depends on TOUCHSCREEN_FT5X06
       help
         Say Y here if you need a ft5X06 apk test in driver.
	 else say N


config TOUCHSCREEN_FT5X06_SUB
       bool "FocalTech touchscreens sub function realized in driver"
       depends on TOUCHSCREEN_FT5X06
       help
         Say Y here if you need a ft5X06 as sub TP in driver.
	 else say N

config TOUCHSCREEN_FT5X06_GFF_PANNEL
       bool "FocalTech touchscreens GFF_PANNEL not support diffshow node in driver"
       depends on TOUCHSCREEN_FT5X06
       help
         Say Y here if you ft5X06 is a GFF_IC in driver.
	 else say N
```

## drivers/sensors/HS_SNS_DRV/Kconfig
```kconfig
#
# hisense sensors device configuration
#

menu "Hisense sensors device support"
	depends on SENSORS

config HS_SNS_ACC
	bool "Provide Accelerometer Device Support"
	default n
	depends on SENSORS
	help
	  Say Y here, a list of availible accelerometer chips shall be shown.
	  Then you can select one or more chip for one project.

choice
	prompt "Choice Acc sensor plant side"
	default HS_SNS_ADSP_ACC
	depends on HS_SNS_ACC

config HS_SNS_AP_ACC
	bool "The Acc sensor plant in the AP side"

config HS_SNS_ADSP_ACC
	bool "The Acc sensor plant in the ADSP side"
	select HS_SNS_STEP

endchoice

config HS_SNS_KXTJ9
	bool "Kionix kxt* serial Acc chips"
	depends on HS_SNS_AP_ACC
	default n
	help
		Say y here if you want to use Kionix kxtj9 kxtj2 kxtik1004 acc chips.

config HS_SNS_MC3XXX
	bool "mCube mc3xxx serial Acc chips"
	depends on HS_SNS_AP_ACC
	default n
	help
		Say y here if you want to use mCube mc3xxx serial acc chips.

config ACC_SENSOR_VENDOR
	string "ACC SENSOR VENDOR"
	depends on HS_SNS_ADSP_ACC
	default ""
	help
		Add vendor info for ACC sensor.

config ACC_SENSOR_TYPE
	string "ACC SENSOR TYPE"
	depends on HS_SNS_ADSP_ACC
	default ""
	help
		Add type info for ACC sensor.

config HS_SNS_MAG
	bool "Provide Magnetic Device Support"
	default n
	depends on HS_SNS_ACC
	help
		Say Y here, a list of availible Magnetic chips shall be shown.
		Then you can select one or more chip for one project.
	
choice
	prompt "Choice Mag sensor plant side"
	default HS_SNS_ADSP_MAG
	depends on HS_SNS_MAG

config HS_SNS_AP_MAG
	bool "The Mag sensor plant in the AP side"

config HS_SNS_ADSP_MAG
	bool "The Mag sensor plant in the ADSP side"

endchoice

config HS_SNS_AKM09911
	bool "AKM akm09911 Mag chips"
	default n
	depends on HS_SNS_AP_MAG
	help
		Say y here if you want to use AKM akm09911 Mag chips.

config MAG_SENSOR_VENDOR
	string "MAG SENSOR VENDOR"
	depends on HS_SNS_ADSP_MAG
	default ""
	help
		Add vendor info for MAG sensor.
		This option only used for ADSP.

config MAG_SENSOR_TYPE
	string "MAG SENSOR TYPE"
	depends on HS_SNS_ADSP_MAG
	default ""
	help
		Add type info for MAG sensor.
		This option only used for ADSP.

config HS_SNS_GYRO
	bool "Provide Gyroscope Device Support"
	default n
	depends on HS_SNS_ACC
	help
	  Say Y here, a list of availible Gyroscope chips shall be shown.
	  Then you can select one or more chip for one project.
	
choice
	prompt "Choice Gyro sensor plant side"
	default HS_SNS_ADSP_GYRO
	depends on HS_SNS_GYRO

config HS_SNS_AP_GYRO
	bool "The Mag sensor plant in the AP side"

config HS_SNS_ADSP_GYRO
	bool "The Mag sensor plant in the ADSP side"

endchoice

config GYRO_SENSOR_VENDOR
	string "GYRO SENSOR VENDOR"
	depends on HS_SNS_ADSP_GYRO
	default ""
	help
		Add vendor info for GYRO sensor.
		This option only used for ADSP.

config GYRO_SENSOR_TYPE
	string "GYRO SENSOR TYPE"
	depends on HS_SNS_ADSP_GYRO
	default ""
	help
		Add type info for GYRO sensor.
		This option only used for ADSP.

config HS_SNS_ALS_PS
	bool "Provide Optical Sensor Device Support"
	default n
	depends on SENSORS
	help
		Say Y here, a list of availible Optical Sensor chips shall be shown.

config HS_SNS_ALS
	bool "Provide Optical Sensor Device Support"
	default n
	depends on SENSORS
	help
		Say Y here, a list of availible Optical Sensor chips shall be shown.

config HS_SNS_AP_RGB
	bool "Provide RGB Device Support On AP Side"
	depends on HS_SNS_AP_ALS
	default n
	help
		Add support product info for RGB sensor.
		This option only used for AP side.
	
config HS_SNS_STK3X3X
	bool "Sensortek stk3x3x alsps chips"
	default n
    depends on HS_SNS_ALS_PS
	help
	    Say y here if you want to use Sensortek stk3x3x alsps chips.

config HS_SNS_CM36686
	bool "Capella cm36686 alsps chips"
	default n
	depends on HS_SNS_ALS_PS
	help
		Say y here if you want to use Capella cm36686 alsps chips.
		
config HS_SNS_STK3X1X
	bool "Sensortek stk3x1x alsps chips"
	default n
    depends on HS_SNS_ALS_PS || HS_SNS_ALS
	help
	    Say y here if you want to use Sensortek stk3x1x alsps chips.

config SMALL_HOLE_CM36686S
	bool "Capella cm36686s small hole alsps chips"
	depends on HS_SNS_CM36686
	default n
	help
		Say Y here if you want to use Capella cm36686s small hole alsps chips.

config HS_SNS_CM36686_PS
	bool "Select PS function Support for CM36686 On AP Side"
	default y
	depends on HS_SNS_CM36686

config HS_SNS_CM36686_ALS
	bool "Select ALS function Support for CM36686 On AP Side"
	default n
	depends on HS_SNS_CM36686

config USE_WHITE_CHANNEL_COMPENSATION
	bool "Capella cm36686 white channel compensation"
	default n
	depends on HS_SNS_CM36686
	help
		Say Y here if you want to use Capella cm36686 white channel compensation.

config HS_SNS_CM32183
	bool "Capella cm32183 als chips"
	default n
	depends on HS_SNS_ALS_PS
	help
		Say y here if you want to use Capella cm32183 alsps chips.

config HS_SNS_ELAN_ALSPS
	bool "Elan epl2590/epl88055 alsps chips"
	default n
	depends on HS_SNS_ALS_PS
	help
		Say y here if you want to use Elan epl2590/epl88055 alsps chips.

config HS_SNS_TMD2725
	bool "AMS tmd2725 alsps chips"
	default n
	depends on HS_SNS_ALS_PS
	help
		Say y here if you want to use AMS tmd2725 alsps chips.

config HS_SNS_TMD3702
	bool "AMS tmd3702 RGB alsps chips"
	default n
	depends on HS_SNS_ALS_PS
	help
		Say y here if you want to use AMS tmd3702 alsps chips.

config HS_SNS_CM3232
	bool "Capella cm3232 als chips"
	default n
	depends on HS_SNS_ALS_PS
	help
		Say y here if you want to use Capella cm3232 als chips.

config HS_SNS_SAR
	bool "Provide Optical Sensor Device Support"
	default n
	depends on SENSORS
	help
		Say Y here, a list of availible Optical Sensor chips shall be shown.
		
config HS_SNS_A96T346
	bool "a96t346 sar chips"
	default n
    depends on HS_SNS_SAR
	help
	    Say y here if you want to use Sensortek a96t346 sar chips.
	    	
config HS_SNS_UV
	bool "Provide Single UV Device Support"
	default n
	depends on HS_SNS_ALS_PS
	help
		Say Y here, a list of availible Proximity chips shall be shown.
		Then you can select only one chip for one project. 

config HS_SNS_SI1133
	bool "SILABS SI1133 chips"
	default n		
	depends on HS_SNS_UV
	help
		Say y here if you want to use SILABS SI1133 als chips.
		
config HS_SNS_BARO
	bool "Provide Pressure Device Support"
	default n
	depends on SENSORS
	help
		Say Y here, a list of availible Pressure chips shall be shown.
		Then you can select only one chip for one project.	
	
choice
	prompt "Choice Pressure sensor plant side"
	default HS_SNS_ADSP_BARO
	depends on HS_SNS_BARO

config HS_SNS_AP_BARO
	bool "The Pressure sensor plant in the AP side"

config HS_SNS_ADSP_BARO
	bool "The Pressure sensor plant in the ADSP side"

endchoice

config BARO_SENSOR_VENDOR
	string "BARO SENSOR VENDOR"
	depends on HS_SNS_ADSP_BARO
	default ""
	help
		Add vendor info for Pressure sensor.
		This option only used for ADSP.

config BARO_SENSOR_TYPE
	string "BARO SENSOR TYPE"
	depends on HS_SNS_ADSP_BARO
	default ""
	help
		Add type info for Pressure sensor.
		This option only used for ADSP.

config HS_SNS_TEM_HUM
	bool "Provide Temperature and Humidity Device Support"
	default n
	depends on SENSORS
	help
	  Say Y here, a list of availible Temperature and Humidity chips shall be shown.
	  Then you can select only one chip for one project.
	
choice
	prompt "Choice Temperature and Humidity sensor plant side"
	default HS_SNS_ADSP_TEM_HUM
	depends on HS_SNS_TEM_HUM

config HS_SNS_AP_TEM_HUM
	bool "The Temperature and Humidity sensor plant in the AP side"

config HS_SNS_ADSP_TEM_HUM
	bool "The Temperature and Humidity sensor plant in the ADSP side"

endchoice

config TEM_HUM_SENSOR_VENDOR
	string "TEM_HUM SENSOR VENDOR"
	depends on HS_SNS_ADSP_TEM_HUM
	default ""
	help
		Add vendor info for Pressure sensor.
		This option only used for ADSP.

config TEM_HUM_SENSOR_TYPE
	string "TEM_HUM SENSOR TYPE"
	depends on HS_SNS_ADSP_TEM_HUM
	default ""
	help
		Add type info for Pressure sensor.
		This option only used for ADSP.

config HS_SNS_STEP
	bool "Provide Step Counter / Detector Support"
	default n
	depends on HS_SNS_ADSP_ACC
	help
	  Say Y here, a list of availible Step Counter / Detector shall be shown.
	  Then you can select only one chip for one project.
	
config HS_SNS_HALL
	bool "Provide Hall Device Support"
	default n
	depends on SENSORS
	help
	  Say Y here, select hall chip .


endmenu
```
