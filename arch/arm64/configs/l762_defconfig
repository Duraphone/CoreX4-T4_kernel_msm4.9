## drivers/sensors/Kconfig
```kconfig
config SENSORS
	bool "Sensors Class Support"
	help
	  This option enables the sensor sysfs class in /sys/class/sensors.
	  You'll need this to do anything useful with sensorss. If unsure, say N.
config SENSORS_SSC
	bool "Enable Sensors Driver Support for SSC"
	help
	  Add support for sensors SSC driver.
	  This driver is used for exercising sensors use case,
	  time syncing with ADSP clock.
config MIRROR_SWITCH
	bool "Enable Mirror Switch "
	help
	  Add support for mirror driver.
	  This driver is used for switching mirror.
source "drivers/sensors/HS_SNS_DRV/Kconfig"
```

## drivers/soc/hisense/base/Kconfig
```kconfig
comment "Hisense product Infomation"
config MACH_HISENSE_SMARTPHONE
	bool "HISENSE SMARTPHONE"
	default n
	help
	  Support for the hisense samrtphone board.

config HISENSE_VENDOR_NAME
	depends on MACH_HISENSE_SMARTPHONE
	string "Hisense vendor info"
	default ""
	help
	  The vendor name of product.

config HISENSE_PRODUCT_NAME
	depends on MACH_HISENSE_SMARTPHONE
	string "Hisense product info"
	default ""
	help
	  The product name.

config HISENSE_PRODUCT_PLATFORM
	depends on MACH_HISENSE_SMARTPHONE
	string "Hisense product platform"
	default ""
	help
	  The platform of product.

config SAVE_AWAKEN_EVENT
	depends on MACH_HISENSE_SMARTPHONE
        bool "save the current awaken event"
	default y
	help
	  enable save the current awaken event
	  if unsure, say N

config HIDE_COMPILE_HOST
	bool "set LINUX_COMPILE_HOST to a fixed string"
	depends on MACH_HISENSE_SMARTPHONE
	default n
	help
	  To hide the real compile host name, if unsure, say N.

config HISENSE_RESTART_MODEM
	bool "Hisense restart modem subsystem by ap"
	depends on HISENSE_DEBUG_CTRL
	default n
	help
	  Provide a node to restart modem by ap.
```

## drivers/soc/hisense/debug/Kconfig
```kconfig
config HISENSE_SERIAL_CONSOLE_CTRL
	bool "add the serial console control code"
	depends on HISENSE_DEBUG_CTRL
	default n
	help
	  Enable it can control the console register for serial.
	  if unsure, say N

config HS_POWERON_REASON
	bool "show device power on/off reason"
	depends on HISENSE_DEBUG_CTRL
	default n
	help
	  Provide a node to show power on/off reason

config HISENSE_SHOW_BOOTLOG
	bool "show bootloader log"
	depends on HISENSE_DEBUG_CTRL
	default n
	help
	  If enable, you can get boot log via
	  "cat /d/debug_control/boot_log"

config HISENSE_SILENCE_REBOOT
	bool "hisense silence reboot"
	depends on HISENSE_PANIC_HANDLE
	default n
	help
	  Feature to enable silence reboot

config PRINTK_PROCESS_INFO
	bool "add print process pid and name"
	depends on MACH_HISENSE_SMARTPHONE
	default y
	help
	  Enable it when want to add the process info for printk
```

## drivers/soc/hisense/efuse/Kconfig
```kconfig
config HISENSE_FUSE_STATUS
	bool "read the fuse status for the customer."
	default n
	help
	  add the fuse status node to read.
```

## drivers/soc/hisense/mm/Kconfig
```kconfig
config HISENSE_SWAPPINESS_OPT
	bool "optimize swap memory"
	default n
	depends on MACH_HISENSE_SMARTPHONE
	help
	  Enable it to swap anon pages to swap
```

## drivers/soc/hisense/pmic/Kconfig
```kconfig
config COMP_MULTI_PROFILE
	bool "multi profile load depend on batt_id"
	depends on OF_BATTERYDATA && MACH_HISENSE_SMARTPHONE
	default n
	help
	 y to use batt id select battery profile.
	 n not using batt id select battery profile.
	 
config HISENSE_CHARGE_FG_FUNCTION
	bool "Add the hisense charge/fg driver"
	depends on MACH_HISENSE_SMARTPHONE
	default n
	help
	  Add the hisense charge function.Such as smb-charger,fg and so on.

config HISENSE_CHARGER_MODE_DET
  bool "zc and typec charger mode detection"
  default n
  help
    ay Y to enable Hisense charger mode detection

config HISENSE_PARALLEL_CHARGER
  bool "paraller charger mode function"
  default n
  help
    ay Y to enable Hisense prraller charger mode

config HS_GET_CAPACITY_DELAY
  bool "HS_GET_CAPACITY_DELAY"
  default n
  help
    ay Y delay to get capacity
	
config HISENSE_NO_BATTERY_DETECT
  bool "HISENSE_NO_BATTERY_DETECT"
  default n
  help
    ay Y detect no battery by thermal
```

## drivers/soc/hisense/rs_recorder/Kconfig
```kconfig
config RS_RECORDER_SUPPORT
	bool "support runtime state recoder"
	depends on HISENSE_DEBUG_CTRL
	default n
	help
	  print error info to buffer when happen runtime error

config SUPPORT_WARM_RESET
	bool "current platform support warm reset"
	depends on RS_RECORDER_SUPPORT
	default n
	help
	  If use platform support warm reset, then say Y,
	  or N.

config EXCEPTION_MONITOR
	bool "module exception monitor"
	depends on HISENSE_DEBUG_CTRL
	default n
	help
	  Collect and save the exception log of all modules.
```

## drivers/soc/hisense/usb/Kconfig
```kconfig
config HISENSE_BACKDOOR_CHOOSE
	bool "HISENSE_BACKDOOR_CHOOSE_FEATURE"
	depends on HISENSE_USB_FEATURE
	default n
	help
	  Implement CHOOSE Hisense USB adb backdoor feature.

config HISENSE_USB_GPIO_ID_FEATURE
	bool "Enable hisense usb gpio id feature"
	depends on MACH_HISENSE_SMARTPHONE
	default n
	help
	  Enable the config if enable hisense usb feature.
	  If unsure, say N

config HISENSE_OTG_FEATURE
	bool "HISENSE_OTG_FEATURE"
	default n
	help
	  Enable the config if enable hisense otg feature .
	  If unsure, say N
	  
config HISENSE_TYPEC_OTG
	bool "HISENSE_TYPEC_OTG"
	default n
	help
	  Enable the config if enable hisense typec otg feature .
	  If unsure, say N
```

## fs/sdcardfs/Kconfig
```kconfig
config SDCARD_FS
	tristate "sdcard file system"
	depends on CONFIGFS_FS
	default n
	help
	  Sdcardfs is based on Wrapfs file system.

config SDCARD_FS_FADV_NOACTIVE
	bool "sdcardfs fadvise noactive support"
	depends on FADV_NOACTIVE
	default y
	help
	  Sdcardfs supports fadvise noactive mode.

config MULTI_USER_ID
	bool "resolve permission between multi user id"
	depends on SDCARD_FS
	default y
	help
	  Sdcardfs supports multi user can read/write same files and dirs.
```

## msm-4.9/drivers/soc/hisense/abnormal_stats/Kconfig
```kconfig
config SUBSYS_ERR_REPORT
	bool "report subsystem failed event by uevent"
	depends on HISENSE_PRODUCT_DEVINFO
	default n
	help
	  Enable it when collect the subsystem state report
	  if unsure, say N

config ABNORMAL_STATS
	bool "statistics the abnormal reboot"
	depends on SUBSYS_ERR_REPORT
	default n
	help
	  record the abnormal reboot count and last reason

config ABNORMAL_STATS_SAVE_FILE
	bool "save abnormal reboot reason string to file"
	depends on ABNORMAL_STATS
	default n
	help
	  If set Y, save abnormal reboot reason to /kdebuginfo/rs_recorder/reboot_stats
```

## msm-4.9/drivers/soc/hisense/sales_name/Kconfig
```kconfig
config PROJECTNAME_REPORT
	depends on HISENSE_PRODUCT_DEVINFO
	bool "project name register of product"
	default n
	help
	  Default use the serial number to report the product name
```
